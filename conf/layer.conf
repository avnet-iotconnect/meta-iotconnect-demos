## conf/layer.conf
```bitbake
# We have a conf and classes directory, add to BBPATH
BBPATH .= ":${LAYERDIR}"

# We have recipes-* directories, add to BBFILES
BBFILES += "${LAYERDIR}/recipes-*/*/*.bb \
            ${LAYERDIR}/recipes-*/*/*.bbappend"

BBFILE_COLLECTIONS += "meta-iotconnect-demos"
BBFILE_PATTERN_meta-iotconnect-demos = "^${LAYERDIR}/"
BBFILE_PRIORITY_meta-iotconnect-demos = "7"

LAYERDEPENDS_meta-iotconnect-demos = "core"
LAYERSERIES_COMPAT_meta-iotconnect-demos = "mickledore"

DISTRO_FEATURES:append = " systemd"
DISTRO_FEATURES_BACKFILL_CONSIDERED += " sysvinit"
VIRTUAL-RUNTIME_init_manager = " systemd"
VIRTUAL-RUNTIME_initscripts = " systemd-compat-units"

# Add demos, you can select either the C demo or Python demo or both
IMAGE_INSTALL += " iotc-c-demo"
IMAGE_INSTALL += " iotc-python-demo"

# install config json and certs folder from recipes-config/iotc-demo-config/files/config-data/
IMAGE_INSTALL += " iotc-demo-config-dev"

# install scripts directory and files from recipes-scripts/iotc-demo-scripts/files/scripts/
IMAGE_INSTALL += " iotc-demo-scripts"
```
